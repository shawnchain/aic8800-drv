## aic8800_sdio/Kconfig
```kconfig
config AIC8800_WLAN_SDIO
	bool "AIC8800 wireless SDIO Support"
	default n
	help
	  This is support for aic wireless sdio chip.

config AIC_FW_8800DC_SDIO_PATH
	depends on AIC8800_WLAN_SDIO
	string "AIC8800DC SDIO Firmware & config file path"
	default "/lib/firmware/aic8800dc_sdio"
	help
	  Path to the aic8800dc sdio firmware & config file.

if AIC8800_WLAN_SDIO
source "drivers/net/wireless/aic8800_sdio/aic8800_fdrv/Kconfig"
source "drivers/net/wireless/aic8800_sdio/aic8800_btlpm/Kconfig"
endif
```

## aic8800_sdio/aic8800_btlpm/Kconfig
```kconfig
config AIC8800_BTLPM_SDIO_SUPPORT
	tristate "AIC8800 bluetooth Driver (SDIO)"
	help
	  This is support for aic bluetooh sdio driver.
```

## aic8800_sdio/aic8800_fdrv/Kconfig
```kconfig
config AIC8800_WLAN_SDIO_SUPPORT
	tristate "AIC8800 wlan Driver (SDIO)"
	help
	  This is support for aic wifi sdio driver.
```

## aic8800_usb/Kconfig
```kconfig
config AIC8800_WLAN_USB
	bool "AIC8800 wireless USB Support"
	default n
	help
	  This is support for aic wireless usb chip.

config AIC_FW_8800_USB_PATH
	depends on AIC8800_WLAN_USB
	string "AIC8800 USB Firmware & config file path"
	default "/lib/firmware/aic8800_usb"
	help
	  Path to the aic8800 generic usb firmware & config file.	

if AIC8800_WLAN_USB
source "drivers/net/wireless/aic8800_usb/aic8800_fdrv/Kconfig"
source "drivers/net/wireless/aic8800_usb/aic_load_fw/Kconfig"
endif
```

## aic8800_usb/aic8800_btusb/Kconfig
```kconfig
config AIC8800_BTUSB_SUPPORT
	tristate "AIC8800 Bluetooth Driver (USB)"
	help
	  This is support for aic wifi usb driver bluetooth feature.
```

## aic8800_usb/aic_load_fw/Kconfig
```kconfig
config AIC_LOADFW_USB_SUPPORT
	tristate "AIC8800 Load Firmware Support (USB)"
	help
	  This is support for aic load firmware usb driver.
```
